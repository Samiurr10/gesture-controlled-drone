## firmware/apps/hand/main/Kconfig.projbuild
```kconfig
menu "PalmPilot hand"

    choice PALMPILOT_HAND_SIDE
        prompt "Hand side"
        default PALMPILOT_HAND_LEFT
        help
            LEFT carries ENABLE (GPIO7) and drives throttle and yaw. RIGHT has
            no button and drives roll and pitch. Build with
            `palmpilot.py build hand:left` or `hand:right`.

        config PALMPILOT_HAND_LEFT
            bool "Left"
        config PALMPILOT_HAND_RIGHT
            bool "Right"
    endchoice

endmenu
```

## firmware/apps/replay/main/Kconfig.projbuild
```kconfig
menu "PalmPilot replay hand"

    choice PALMPILOT_HAND_SIDE
        prompt "Hand side"
        default PALMPILOT_HAND_LEFT
        help
            Which hand this stands in for: `replay:left` or `replay:right`.

        config PALMPILOT_HAND_LEFT
            bool "Left"
        config PALMPILOT_HAND_RIGHT
            bool "Right"
    endchoice

endmenu
```

## firmware/components/palmpilot_core/Kconfig
```kconfig
menu "PalmPilot"
    config PALMPILOT_BENCH
        bool "Bench profile for the first physical flights"
        default n
        help
            Builds the settings used on the physical bench on 2026-11-17 (see
            docs/bench-bringup.md): ENABLE toggles instead of being held, ENABLE
            and arming accept up to 20% throttle, no thumb gestures, the hub
            ignores CALIBRATE, right-hand pitch is inverted and yaw is softened.
            The simulation suites test the default (n).
endmenu
```

## firmware/probes/ble2link/main/Kconfig.projbuild
```kconfig
menu "ble2link probe"
    choice B2L_ROLE
        prompt "Role"
        default B2L_CENTRAL
        config B2L_CENTRAL
            bool "Central (connects both peripherals)"
        config B2L_P1
            bool "Peripheral 1"
        config B2L_P2
            bool "Peripheral 2"
    endchoice
endmenu
```

## firmware/probes/rngreset/sdkconfig.defaults
```kconfig
CONFIG_ESPTOOLPY_FLASHMODE_DIO=y
CONFIG_ESPTOOLPY_FLASHFREQ_40M=y
CONFIG_ESPTOOLPY_FLASHSIZE_4MB=y
CONFIG_ESP_CONSOLE_UART_DEFAULT=y
CONFIG_ESP_CONSOLE_SECONDARY_USB_SERIAL_JTAG=y
CONFIG_FREERTOS_UNICORE=y
CONFIG_LOG_DEFAULT_LEVEL_WARN=y
```
